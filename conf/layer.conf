## conf/layer.conf
```bitbake
# We have a conf and classes directory, add to BBPATH
BBPATH .= ":${LAYERDIR}"

# We have recipes-* directories, add to BBFILES
BBFILES += "${LAYERDIR}/recipes-*/*/*.bb \
            ${LAYERDIR}/recipes-*/*/*.bbappend"

BBFILE_COLLECTIONS += "meta-microservices"
BBFILE_PATTERN_meta-microservices = "^${LAYERDIR}/"
BBFILE_PRIORITY_meta-microservices = "6"

LAYERDEPENDS_meta-microservices = "core"
LAYERSERIES_COMPAT_meta-microservices = "scarthgap"
```
